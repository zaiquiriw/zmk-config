## config/boards/shields/leto/Kconfig.defconfig
```kconfig
if SHIELD_LETO_LEFT

config ZMK_KEYBOARD_NAME
	default "Leto"

config ZMK_SPLIT_ROLE_CENTRAL
	default y

endif

if SHIELD_LETO_LEFT || SHIELD_LETO_RIGHT

config ZMK_SPLIT
	default y

endif
```

## config/boards/shields/leto/Kconfig.shield
```kconfig
config SHIELD_LETO
	def_bool $(shields_list_contains,leto)

config SHIELD_LETO_LEFT
    def_bool $(shields_list_contains,leto_left)

config SHIELD_LETO_RIGHT
    def_bool $(shields_list_contains,leto_right)
```
