// leto_right.overlay

#include "leto.dtsi"

&default_transform { // The matrix transform for this board is 5 columns over because the left half is 5 columns wide according to the matrix.
    col-offset = <5>;
};

&kscan0 {
    row-gpios
            = <&pro_micro 3 GPIO_ACTIVE_HIGH> // Row 1 from the drawing.
            , <&pro_micro 2 GPIO_ACTIVE_HIGH> // Row 2 from the drawing.
        	, <&pro_micro 18 GPIO_ACTIVE_HIGH> // Row 3 from the drawing.
            , <&pro_micro 14 GPIO_ACTIVE_HIGH> // Row 4 from the drawing.
            , <&pro_micro 10 GPIO_ACTIVE_HIGH> // Row 5 from the drawing.
            ;
};


&left_encoder {
	status = "okay";	
};