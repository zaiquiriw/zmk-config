// leto_left.overlay

#include "leto.dtsi" // Notice that the main dtsi files are included in the overlay.

&kscan0 {
    row-gpios
            = <&pro_micro 3 GPIO_ACTIVE_HIGH> // Row 1 from the drawing.
            , <&pro_micro 2 GPIO_ACTIVE_HIGH> // Row 2 from the drawing.
        	, <&pro_micro 18 GPIO_ACTIVE_HIGH> // Row 3 from the drawing.
            , <&pro_micro 14 GPIO_ACTIVE_HIGH> // Row 4 from the drawing.
            , <&pro_micro 10 GPIO_ACTIVE_HIGH> // Row 5 from the drawing.
            ;
};